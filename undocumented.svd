# RP1 register map
Vendor: Raspberry Pi; File version: 0.1
CPU: CM3, little endian, MPU, no FPU, 58 interrupts
Registers are access not given, no defined reset value unless marked. A register's access mark holds for its fields unless they carry their own. Offsets are from the block's base; lines under a group give offsets from that group; [hi:lo] are bit positions; {n}, {i} and the like mark numbered series; 'fields as' and 'values as' point back to an identical list; <NAME> marks a mode.

## Memory map
0x40018000 clocks_main size 0x1000 — the main clock controller
0x40030000 UART0 size 0x1000
0x40034000 UART1 size 0x1000
0x40038000 UART2 size 0x1000
0x4003C000 UART3 size 0x1000
0x40040000 UART4 size 0x1000
0x40044000 UART5 size 0x1000
0x40154000 watchdog size 0x1000
0xF0000000 PIO size 0x1000
0xF0004000 PROC_RIO

## Interrupts
25 UART0_IRQ (UART0)
42 UART1_IRQ (UART1)
43 UART2_IRQ (UART2)
44 UART3_IRQ (UART3)
45 UART4_IRQ (UART4)
46 UART5_IRQ (UART5)

## clocks_main — the main clock controller
Base 0x40018000
0x21C FC0_REF_KHZ — the rate of clk_slow_sys in khz (currently, 50mhz)
0x220 FC0_MIN_KHZ — linux sets this to 0
0x224 FC0_MAX_KHZ — linux sets this to 0x1ffffff
0x228 FC0_DELAY — linux sets this to 7
0x22C FC0_INTERVAL — linux sets this to 8
0x230 FC0_SRC — the clock tap to measure, 0 to disable
0x234 FC0_STATUS — the status of this FC
  [?] RUNNING, [?] DONE
0x238 FC0_RESULT — the measured clock

## watchdog
Base 0x40154000
0x0C SCRATCH0 — watchdog scratch 0, must contain 0xb007c0de for bootrom to pass on control
0x10 SCRATCH1 — watchdog scratch 1, contains `pc ^ 0xb007c0de` when starting core0
0x14 SCRATCH2 — watchdog scratch 2, contains `pc ^ 0xb007c0de ^ 0xfffffff3`, core1 entry point
0x18 SCRATCH3 — watchdog scratch 3, contains core0 initial sp
0x1C SCRATCH4 — watchdog scratch 4, contains core1 initial sp

## PIO
Base 0xF0000000
0x00 PIO_CTRL
0x04 PIO_FSTAT
0x08 PIO_FDEBUG
0x0C PIO_FLEVEL — When joined, the FIFOs maximum level is 16. The levels here read as 15 when the level is 15 or 16.
0x10 PIO_FLEVEL_HI — Same layout as FLEVEL, but showing the top bit of the level, so 1 when the level is 16, zero otherwise.
{0x14+4i} PIO_TXF{i} (i=0..3)
{0x24+4i} PIO_RXF{i} (i=0..3)
0x40 PIO_DBG_PADOUT
0x44 PIO_DBG_PADOE
0x48 PIO_DBG_CFGINFO
0x4C PIO_INSTR_MEM0
0xCC PIO_SM0_CLKDIV
0xD0 PIO_SM0_EXECCTRL — Bit 5 (reserved in RP2040) is settable, but has unknown function
0xD4 PIO_SM0_SHIFTCTRL
0xD8 PIO_SM0_ADDR
0xDC PIO_SM0_INSTR
0xE0 PIO_SM0_PINCTRL
0xE4 PIO_SM0_TX_DMA
  [10:7] unknown, smaller values make dma faster, [?] Enable DREQ, [?] Current DREQ status, [4:0] DREQ threshold (DREQ asserted when TX FIFO below this level)
0xE8 PIO_SM0_RX_DMA
  [10:7] unknown, smaller values make dma faster, [?] Enable DREQ, [?] Current DREQ status, [4:0] DREQ threshold (DREQ asserted when RX FIFO above this level)
